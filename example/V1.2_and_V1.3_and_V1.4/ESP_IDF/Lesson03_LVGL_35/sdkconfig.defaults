## example/V1.2_and_V1.3_and_V1.4/ESP_IDF/Lesson04_DHT_Screen_35/sdkconfig.defaults
```kconfig
CONFIG_ESPTOOLPY_FLASHSIZE_16MB=y
CONFIG_PARTITION_TABLE_CUSTOM=y
CONFIG_PARTITION_TABLE_CUSTOM_FILENAME="partitions.csv"
CONFIG_PARTITION_TABLE_FILENAME="partitions.csv"
CONFIG_LV_CONF_SKIP=y
CONFIG_LV_DEF_REFR_PERIOD=5
CONFIG_LV_FONT_MONTSERRAT_20=y
# CONFIG_LV_BUILD_EXAMPLES is not set
```
